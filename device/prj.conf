## CMakeLists.txt
```
cmake_minimum_required(VERSION 3.20.0)
find_package(Zephyr REQUIRED HINTS $ENV{ZEPHYR_BASE})
project(app)

if(NOT CONFIG_DEBUG)
    add_definitions(-DNDEBUG)
endif()

target_link_libraries(app PRIVATE
    uhk
    uhk-shared
)

if(CONFIG_BOARD_UHK_60_RIGHT)
    target_sources(app PRIVATE
        src/uhk60/main.c
    )
else()
    target_sources(app PRIVATE
        src/main.c
    )
endif()
```

## Kconfig
```
source "Kconfig.zephyr"

rsource "c2usb/c2usb/port/zephyr/Kconfig"

# custom Kconfig defaults are set per board here,
# as the board-specific Kconfig files are used for mcuboot build as well
config DEVICE_ID
    int "UHK device id"
    default 5 if BOARD_UHK_DONGLE
    default 3 if BOARD_UHK_80_LEFT
    default 4 if BOARD_UHK_80_RIGHT
    help
        The device id that identifies the specific UHK half or dongle.

config KEYBOARD_MAX_SCANCODE
    hex "highest keyboard scancode"
    default 0x86
    range 0x66 0xDD
    help
        The highest keyboard scancode value influences the overall length of the HID record sent to the host.
        The default is set so Android devices (which don't exchange the MTU from the default 23)
        still receive the "NKRO" report layout. If a higher scancode is used, the report size will exceed this size,
        causing a fallback to 6KRO report layout on Android.

# by using the same Kconfig symbol names as mcuboot, the board Kconfig files can contain the values
config USB_DEVICE_VID
    hex "USB vendor ID"
    range 0x0000 0xFFFF
    default 0x37A8
    help
        The USB vendor ID is used to identify the specific UHK device.

config USB_DEVICE_MANUFACTURER
    string "USB vendor name"
    default "Ultimate Gadget Laboratories"
    help
        The USB vendor name is used to describe the specific UHK device to the host OS user.

config USB_DEVICE_PID
    hex "USB product ID"
    range 0x0000 0xFFFF
    help
        The USB product ID is used to identify the specific UHK device.

config USB_DEVICE_PRODUCT
    string "USB product name"
    help
        The USB product name is used to describe the specific UHK device to the host OS user.

config USB_DEVICE_PRODUCT_VERSION
    hex "USB product version"
    range 0x0000 0xFFFF
    default 0x0001
    help
        The USB product version is used to identify the UHK device operating mode.

# copy over the USB properties to BT
configdefault BT_DIS_MANUF
    default USB_DEVICE_MANUFACTURER
configdefault BT_DIS_MODEL
    default USB_DEVICE_PRODUCT
configdefault BT_DIS_PNP
    default y
configdefault BT_DIS_PNP_VID_SRC
    default 2
configdefault BT_DIS_PNP_VID
    default USB_DEVICE_VID
configdefault BT_DIS_PNP_VER
    default USB_DEVICE_PRODUCT_VERSION

configdefault BT_DEVICE_NAME
    default "UHK 80" if BOARD_UHK_80_LEFT || BOARD_UHK_80_RIGHT
configdefault BT_DEVICE_APPEARANCE
    default 961
```

## prj.conf
```kconfig
CONFIG_PINCTRL=y
CONFIG_RETAINED_MEM=y
CONFIG_RETENTION=y
CONFIG_RETENTION_BOOT_MODE=y

CONFIG_EXTRA_EXCEPTION_INFO=y
CONFIG_INIT_STACKS=y

CONFIG_CPP=y
CONFIG_STD_CPP20=y
CONFIG_NEWLIB_LIBC=y
CONFIG_GLIBCXX_LIBCPP=y

CONFIG_UDC_DRIVER=y

CONFIG_NCS_SAMPLES_DEFAULTS=y

CONFIG_BT=y
# CONFIG_BT_DEBUG_LOG=y
CONFIG_BT_MAX_CONN=2
CONFIG_BT_MAX_PAIRED=2
CONFIG_BT_SMP=y
CONFIG_BT_L2CAP_TX_BUF_COUNT=5
CONFIG_BT_PERIPHERAL=y

CONFIG_BT_BAS=y

CONFIG_BT_DIS=y

CONFIG_BT_SETTINGS=y
CONFIG_FLASH=y
CONFIG_FLASH_PAGE_LAYOUT=y
CONFIG_FLASH_MAP=y
CONFIG_NVS=y
CONFIG_SETTINGS=y

CONFIG_SERIAL=y

CONFIG_CONSOLE=y
CONFIG_UART_CONSOLE=y
CONFIG_UART_LINE_CTRL=y
CONFIG_UART_ASYNC_API=y

CONFIG_SHELL=y
CONFIG_SHELL_VT100_COMMANDS=y
CONFIG_SHELL_VT100_COLORS=y
CONFIG_BT_SHELL=y
CONFIG_SHELL_BT_NUS=y
CONFIG_HWINFO=y
CONFIG_HWINFO_SHELL=y
CONFIG_I2C=y
CONFIG_I2C_SHELL=y
CONFIG_STREAM_FLASH=y
CONFIG_SETTINGS_SHELL=y
CONFIG_SHELL_BACKENDS=y

CONFIG_USE_SEGGER_RTT=y
CONFIG_RTT_CONSOLE=y
CONFIG_SHELL_BACKEND_SERIAL=y
CONFIG_SHELL_BACKEND_RTT=y
# CONFIG_LOG_BACKEND_RTT=y
CONFIG_BUILD_OUTPUT_HEX=y

CONFIG_BT_CENTRAL=y
CONFIG_BT_GATT_CLIENT=y
CONFIG_BT_OBSERVER=y
CONFIG_BT_NUS=y
CONFIG_BT_NUS_CLIENT=y
CONFIG_BT_SCAN=y
CONFIG_BT_SCAN_FILTER_ENABLE=y
CONFIG_BT_SCAN_UUID_CNT=1
CONFIG_BT_GATT_DM=y
CONFIG_HEAP_MEM_POOL_SIZE=2048
CONFIG_BT_SCAN_ADDRESS_CNT=2
CONFIG_WARN_EXPERIMENTAL=n

CONFIG_BT_GAP_AUTO_UPDATE_CONN_PARAMS=n

CONFIG_BT_USER_DATA_LEN_UPDATE=y
CONFIG_BT_BUF_ACL_RX_SIZE=251
CONFIG_BT_BUF_ACL_TX_SIZE=251
CONFIG_BT_L2CAP_TX_MTU=247

CONFIG_BT_ATT_PREPARE_COUNT=4

CONFIG_UDC_DRIVER_LOG_LEVEL_WRN=y

# Apply config requires deep stack, and since Agent expects response code,
# we can't just do it from the main thread
CONFIG_C2USB_UDC_MAC_THREAD_STACK_SIZE=2048
```

## src/main.c
```c
#include "main.h"
#include "bt_advertise.h"
#include "nus_client.h"
#include "nus_server.h"
#include "bt_manager.h"
#include "legacy/config_parser/config_globals.h"
#include "legacy/ledmap.h"
#include "shared/attributes.h"
#include "zephyr/kernel.h"
#include "zephyr/storage/flash_map.h"
#include "keyboard/key_scanner.h"
#include "keyboard/leds.h"
#include "keyboard/oled/oled.h"
#include "keyboard/charger.h"
#include "keyboard/spi.h"
#include "keyboard/uart.h"
#include "keyboard/i2c.h"
#include "peripherals/merge_sensor.h"
#include "shell.h"
#include "device.h"
#include "usb/usb.h"
#include "bt_conn.h"
#include "settings.h"
#include "flash.h"
#include "usb_commands/usb_command_apply_config.h"
#include "macros/shortcut_parser.h"
#include "macros/keyid_parser.h"
#include "macros/core.h"
#include "legacy/timer.h"
#include "legacy/user_logic.h"
#include "legacy/config_manager.h"
#include "messenger.h"
#include "legacy/led_manager.h"
#include "legacy/debug.h"
#include "state_sync.h"
#include "keyboard/charger.h"
#include <stdint.h>
#include "dongle_leds.h"
#include "debug_eventloop_timing.h"
#include <zephyr/drivers/gpio.h>
#include "dongle_leds.h"
#include <zephyr/drivers/gpio.h>

k_tid_t Main_ThreadId = 0;

static void sleepTillNextMs() {
    static uint64_t wakeupTimeUs = 0;
    const uint64_t minSleepTime = 100;
    uint64_t currentTimeUs = k_cyc_to_us_near64(k_cycle_get_32());

    wakeupTimeUs = wakeupTimeUs+1000;

    if (currentTimeUs < wakeupTimeUs) {
        k_usleep(MAX(wakeupTimeUs-currentTimeUs, minSleepTime));
    } else {
        k_usleep(minSleepTime);
        wakeupTimeUs = currentTimeUs;
    }
}


static K_SEM_DEFINE(mainWakeupSemaphore, 1, 1);

static void scheduleNextRun() {
    uint32_t nextEventTime = 0;
    bool eventIsValid = false;
    if (EventScheduler_Vector & EventVector_EventScheduler) {
        nextEventTime = EventScheduler_Process();
        eventIsValid = true;
    }
    CurrentTime = k_uptime_get();
    int32_t diff = nextEventTime - CurrentTime;

    k_sem_take(&mainWakeupSemaphore, K_NO_WAIT);
    bool haveMoreWork = (EventScheduler_Vector & EventVector_UserLogicUpdateMask);
    if (haveMoreWork) {
        LOG_SCHEDULE( EventVector_ReportMask("Continuing immediately because of: ", EventScheduler_Vector & EventVector_UserLogicUpdateMask););
        EVENTLOOP_TIMING(printk("Continuing immediately\n"));
        // Mouse keys don't like being called twice in one second for some reason
        k_sem_give(&mainWakeupSemaphore);
        sleepTillNextMs();
        return;
    } else if (eventIsValid) {
        EVENTLOOP_TIMING(printk("Sleeping for %d\n", diff));
        k_sem_take(&mainWakeupSemaphore, K_MSEC(diff));
        // k_sleep(K_MSEC(diff));
    } else {
        EVENTLOOP_TIMING(printk("Sleeping forever\n"));
        k_sem_take(&mainWakeupSemaphore, K_FOREVER);
        // k_sleep(K_FOREVER);
    }
}

//TODO: inline this
void Main_Wake() {
    k_sem_give(&mainWakeupSemaphore);
    // k_wakeup(Main_ThreadId);
}

int main(void) {
    Main_ThreadId = k_current_get();
    printk("----------\n" DEVICE_NAME " started\n");

    const struct gpio_dt_spec led0 = GPIO_DT_SPEC_GET(DT_ALIAS(led0_green), gpios);
    gpio_pin_configure_dt(&led0, GPIO_OUTPUT);
    DongleLeds_Set(true, true, true);
    gpio_pin_set_dt(&led0, true);
    k_sleep(K_MSEC(1000));
    DongleLeds_Set(false, false, false);
    gpio_pin_set_dt(&led0, false);
    k_sleep(K_MSEC(10000));
//    k_sleep(K_MSEC(1000000000));

    if (DEVICE_IS_UHK80_RIGHT) {
        flash_area_open(FLASH_AREA_ID(hardware_config_partition), &hardwareConfigArea);
        flash_area_open(FLASH_AREA_ID(user_config_partition), &userConfigArea);
    }

    if (!DEVICE_IS_UHK_DONGLE) {
        InitUart();
        InitZephyrI2c();
        InitSpi();

#if DEVICE_HAS_OLED
        InitOled();
#endif // DEVICE_HAS_OLED

        InitLeds();

#if DEVICE_HAS_MERGE_SENSOR
        MergeSensor_Init();
#endif // DEVICE_HAS_MERGE_SENSOR

        InitKeyScanner();

    }

    if (DEVICE_IS_UHK80_LEFT || DEVICE_IS_UHK80_RIGHT) {
        ConfigManager_ResetConfiguration(false);
        Ledmap_InitLedLayout();
    }

    if (DEVICE_IS_UHK80_RIGHT) {
        InitFlash();
        printk("Reading hardware config\n");
        Flash_ReadAreaSync(hardwareConfigArea, 0, HardwareConfigBuffer.buffer, HARDWARE_CONFIG_SIZE);
        printk("Reading user config\n");
        Flash_ReadAreaSync(userConfigArea, 0, StagingUserConfigBuffer.buffer, USER_CONFIG_SIZE);
        USB_SetSerialNumber(HardwareConfig->uniqueId);
        printk("Applying user config\n");
        bool factoryMode = false;
         if (factoryMode) {
             LedManager_FullUpdate();
         } else {
             UsbCommand_ApplyConfig();
         }
         printk("User config applied\n");
         ShortcutParser_initialize();
         KeyIdParser_initialize();
         Macros_Initialize();
    }

    USB_EnableHid(); // has to be after USB_SetSerialNumber

    bt_enable(NULL);

    // has to be after bt_enable
    InitSettings();

    // has to be after InitSettings
    BtManager_InitBt();
    BtManager_StartBt();

    if (!DEVICE_IS_UHK_DONGLE) {
        InitCharger(); // has to be after usb initialization
    }

    Messenger_Init();

    StateSync_Init();

#if DEVICE_IS_UHK80_RIGHT
    while (true)
    {
        CurrentTime = k_uptime_get();
        Messenger_ProcessQueue();
        if (EventScheduler_Vector & EventVector_UserLogicUpdateMask) {
            EVENTLOOP_TIMING(EVENTLOOP_TIMING(EventloopTiming_Start()));
            RunUserLogic();
            EVENTLOOP_TIMING(EventloopTiming_End());
        }
        scheduleNextRun();
    }
#else
    while (true)
    {
        CurrentTime = k_uptime_get();
        Messenger_ProcessQueue();
        RunUhk80LeftHalfLogic();
        scheduleNextRun();
    }
#endif
}
```

## src/bt_central_uart.c
```c
#include <bluetooth/services/nus.h>
#include <bluetooth/services/nus_client.h>
#include <bluetooth/scan.h>
#include <zephyr/logging/log.h>
#include "bt_scan.h"
#include "bt_conn.h"
#include "bt_central_uart.h"
#include "bool_array_converter.h"
#include "legacy/slot.h"
#include "shared/bool_array_converter.h"
#include "legacy/module.h"
#include "legacy/key_states.h"
#include "keyboard/oled/widgets/console_widget.h"

#define LOG_MODULE_NAME central_uart
LOG_MODULE_REGISTER(LOG_MODULE_NAME);

static struct bt_nus_client nus_client;

static void ble_data_sent(struct bt_nus_client *nus, uint8_t err, const uint8_t *const data, uint16_t len)
{
    printk("NUS data sent to %s: %i\n", GetPeerStringByConn(nus->conn), len);
    if (err) {
        LOG_WRN("ATT error code: 0x%02X", err);
    }
}

static uint8_t ble_data_received(struct bt_nus_client *nus, const uint8_t *data, uint16_t len)
{
#if DEVICE_IS_UHK80_RIGHT
    printk("Received data: %i %i %i %i %i %i %i %i\n", data[0], data[1], data[2], data[3], data[4], data[5], data[6], data[7]);
    for (uint8_t keyId = 0; keyId < MAX_KEY_COUNT_PER_MODULE; keyId++) {
        KeyStates[SlotId_LeftKeyboardHalf][keyId].hardwareSwitchState = !!(data[keyId/8] & (1 << (keyId % 8)));
    }
#else
    printk("NUS data received from %s: %s\n", GetPeerStringByConn(nus->conn), data);
#endif
    return BT_GATT_ITER_CONTINUE;
}

static void discovery_complete(struct bt_gatt_dm *dm, void *context)
{
    struct bt_nus_client *nus = context;
    LOG_INF("Service discovery completed");

    bt_gatt_dm_data_print(dm);

    bt_nus_handles_assign(dm, nus);
    bt_nus_subscribe_receive(nus);

    bt_gatt_dm_data_release(dm);
}

static void discovery_service_not_found(struct bt_conn *conn, void *context)
{
    LOG_INF("Service not found");
}

static void discovery_error(struct bt_conn *conn, int err, void *context)
{
    LOG_WRN("Error while discovering GATT database: (%d)", err);
}

struct bt_gatt_dm_cb discovery_cb = {
    .completed         = discovery_complete,
    .service_not_found = discovery_service_not_found,
    .error_found       = discovery_error,
};

void gatt_discover(struct bt_conn *conn)
{
    int err = bt_gatt_dm_start(conn, BT_UUID_NUS_SERVICE, &discovery_cb, &nus_client);
    if (err) {
        LOG_ERR("could not start the discovery procedure, error code: %d", err);
    }
}

static void exchange_func(struct bt_conn *conn, uint8_t err, struct bt_gatt_exchange_params *params)
{
    if (!err) {
        LOG_INF("MTU exchange done with %s", GetPeerStringByConn(conn));
    } else {
        LOG_WRN("MTU exchange failed with %s (err %u)", GetPeerStringByConn(conn), err);
    }
}

void SetupCentralConnection(struct bt_conn *conn)
{
    static struct bt_gatt_exchange_params exchange_params;

    exchange_params.func = exchange_func;
    int err = bt_gatt_exchange_mtu(conn, &exchange_params);
    if (err) {
        LOG_WRN("MTU exchange failed with %s, err %d", GetPeerStringByConn(conn), err);
    }

    err = bt_conn_set_security(conn, BT_SECURITY_L2);
    if (err) {
        LOG_WRN("Failed to set security for %s: %d", GetPeerStringByConn(conn), err);
    }

    gatt_discover(conn);

    err = bt_scan_stop();
    if ((!err) && (err != -EALREADY)) {
        LOG_ERR("Stop LE scan failed (err %d)", err);
    }
}

static int nus_client_init(void)
{
    struct bt_nus_client_init_param init = {
        .cb = {
            .received = ble_data_received,
            .sent = ble_data_sent,
        }
    };

    int err = bt_nus_client_init(&nus_client, &init);
    if (err) {
        LOG_ERR("NUS Client initialization failed (err %d)", err);
        return err;
    }

    LOG_INF("NUS Client module initialized");
    return err;
}

void InitCentralUart(void)
{
    int err = scan_init();
    if (err != 0) {
        LOG_ERR("scan_init failed (err %d)", err);
        return;
    }

    err = nus_client_init();
    if (err != 0) {
        LOG_ERR("nus_client_init failed (err %d)", err);
        return;
    }

    err = bt_scan_start(BT_SCAN_TYPE_SCAN_ACTIVE);
    if (err) {
        LOG_ERR("Scanning failed to start (err %d)", err);
        return;
    }

    LOG_INF("Scanning successfully started");
}

void SendCentralUart(const uint8_t *data, uint16_t len)
{
    int err = bt_nus_client_send(&nus_client, data, len);
    if (err) {
        LOG_WRN("Failed to send data over BLE connection (err %d)", err);
    }
}
```

## src/bt_peripheral_uart.c
```c
#include <bluetooth/services/nus.h>
#include "bt_conn.h"
#include "bt_advertise.h"
#include "bt_conn.h"

static void bt_receive_cb(struct bt_conn *conn, const uint8_t *const data, uint16_t len) {
    printk("NUS data received from %s: %i\n", GetPeerStringByConn(conn), len);
}

static void bt_send_cb(struct bt_conn *conn) {
    char addr[BT_ADDR_LE_STR_LEN] = {0};
    bt_addr_le_to_str(bt_conn_get_dst(conn), addr, ARRAY_SIZE(addr));
    printk("NUS data sent to %s\n", GetPeerStringByConn(conn));
}

static struct bt_nus_cb nus_cb = {
    .received = bt_receive_cb,
    .sent = bt_send_cb,
};

void InitPeripheralUart(void) {
    int err = bt_nus_init(&nus_cb);
    if (err) {
        printk("Failed to initialize UART service (err: %d)\n", err);
        return;
    }

    advertise_peer();
}

void SendPeripheralUart(const uint8_t *data, uint16_t len) {
    int err = bt_nus_send(NULL, data, len);
    if (err) {
        printk("Failed to send data over BLE connection (err: %d)\n", err);
    } else {
        printk("Sent data\n");
    }
}
```

## src/bt_scan.c
```c
#include <bluetooth/scan.h>
#include "bt_conn.h"
#include "device.h"

static void scan_filter_match(struct bt_scan_device_info *device_info,
    struct bt_scan_filter_match *filter_match, bool connectable)
{
    printk("Filters matched: %s, connectable:%d\n",
        GetPeerStringByAddr(device_info->recv_info->addr), connectable);
}

static void scan_connecting_error(struct bt_scan_device_info *device_info) {
    printk("Connecting failed: %s\n", GetPeerStringByAddr(device_info->recv_info->addr));
}

static void scan_connecting(struct bt_scan_device_info *device_info, struct bt_conn *conn) {
    printk("Scan connecting: %s\n", GetPeerStringByAddr(device_info->recv_info->addr));
}

BT_SCAN_CB_INIT(scan_cb, scan_filter_match, NULL, scan_connecting_error, scan_connecting);

int scan_init(void) {
    int err;
    struct bt_scan_init_param scan_init = {
        .connect_if_match = 1,
    };

    bt_scan_init(&scan_init);
    bt_scan_cb_register(&scan_cb);

#if DEVICE_IS_UHK80_RIGHT
    err = bt_scan_filter_add(BT_SCAN_FILTER_TYPE_ADDR, &Peers[PeerIdLeft].addr);
    if (err) {
        printk("Scanning filters cannot be set (err %d)\n", err);
        return err;
    }
#endif

#if DEVICE_IS_UHK_DONGLE
    err = bt_scan_filter_add(BT_SCAN_FILTER_TYPE_ADDR, &Peers[PeerIdRight].addr);
    if (err) {
        printk("Scanning filters cannot be set (err %d)\n", err);
        return err;
    }
#endif

    err = bt_scan_filter_enable(BT_SCAN_ADDR_FILTER, false);
    if (err) {
        printk("Filters cannot be turned on (err %d)\n", err);
        return err;
    }

    printk("Scan module initialized\n");
    return err;
}
```
